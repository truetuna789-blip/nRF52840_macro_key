#include <behaviors.dtsi>
#include <dt-bindings/zmk/keys.h>
#include <dt-bindings/zmk/bt.h>

/ {
    keymap {
        compatible = "zmk,keymap";

        // 세트 1 (기본 모드)
        default_layer {
            // 1번~12번 스위치, 13번(인코더 누름: 세트 2로 전환)
            bindings = <
                &kp A  &kp B  &kp C  &kp D  &kp E  &kp F  &kp G  &kp H  &kp I  &kp J  &kp K  &kp L  &tog 1
            >;
            // 인코더 돌리기: 볼륨 크게 / 작게
            sensor-bindings = <&inc_dec_kp C_VOL_UP C_VOL_DN>;
        };

        // 세트 2 (기능 모드 - 인코더를 꾹 누르면 이 세트로 바뀝니다)
        layer_1 {
            // 1번~12번 스위치(일부 블루투스 관리 배정), 13번(인코더 누름: 다시 세트 1로 복귀)
            bindings = <
                &kp N1 &kp N2 &kp N3 &kp N4 &bt BT_SEL 0 &bt BT_SEL 1 &bt BT_CLR &kp N8 &kp N9 &kp N0 &kp MINUS &kp EQUAL &tog 0
            >;
            // 인코더 돌리기: 오른쪽 화살표 / 왼쪽 화살표 (타임라인 이동 등)
            sensor-bindings = <&inc_dec_kp RIGHT LEFT>;
        };
    };
};
